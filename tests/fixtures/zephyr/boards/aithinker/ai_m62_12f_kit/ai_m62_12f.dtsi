/*
 * Copyright (c) 2025 MASSDRIVER EI (massdriver.space)
 *
 * SPDX-License-Identifier: Apache-2.0
 */

#include <bflb/bl616.dtsi>
#include <bflb/bl61x_em_32kb_wifi.dtsi>
#include "ai_m62_12f-pinctrl.dtsi"

&sf_ctrl {
	override-bank1;
	no-header;
};

&sf_bank1 {
	reg = <0xa0000000 0x400000>;
	ranges = <0x0 0xa0000000 0x400000>;

	gd25lq32d: flash@0 {
		compatible = "bflb,sf-flash", "soc-nv-flash";
		reg = <0x0 0x400000>;
		ranges;
		#address-cells = <1>;
		#size-cells = <1>;
		write-block-size = <4>;
		erase-block-size = <DT_SIZE_K(4)>;

		spi-bus-mode = <4>;
		sf-pad = <1>;
		jedec-id = [c8 60 16];
		use-sfdp;


	};
};
